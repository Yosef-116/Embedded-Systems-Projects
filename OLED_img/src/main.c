#define F_CPU 16000000UL 

#include <avr/io.h> 
#include <util/delay.h> 
#include <avr/pgmspace.h>

// Define I2C Pins on Port C 
#define SDA_PIN PC4 
#define SCL_PIN PC5 

// 1. Software (Bit-Banged) I2C Functions
void I2C_Init(void) { 
  // Set SDA and SCL as outputs 
  DDRC |= (1 << SDA_PIN) | (1 << SCL_PIN); 
  // Bring bus lines HIGH (Idle state) 
  PORTC |= (1 << SDA_PIN) | (1 << SCL_PIN); 
} 

void I2C_Start(void) { 
  PORTC |= (1 << SDA_PIN) | (1 << SCL_PIN); 
  _delay_us(4); 
  PORTC &= ~(1 << SDA_PIN); // Pull SDA LOW first 
  _delay_us(4); 
  PORTC &= ~(1 << SCL_PIN); // Pull SCL LOW 
} 

void I2C_Stop(void) { 
  PORTC &= ~(1 << SDA_PIN); 
  PORTC |= (1 << SCL_PIN); // Pull SCL HIGH first 
  _delay_us(4); 
  PORTC |= (1 << SDA_PIN); // Pull SDA HIGH 
  _delay_us(4); 
} 

void I2C_WriteByte(uint8_t byte) { 
  for (uint8_t i = 0; i < 8; i++) { // Setup data bit on SDA line (MSB first) 
    if (byte & 0x80) 
      PORTC |= (1 << SDA_PIN); 
    else 
      PORTC &= ~(1 << SDA_PIN); 
    _delay_us(2); 
    PORTC |= (1 << SCL_PIN); // Clock pulse HIGH 
    _delay_us(2); 
    PORTC &= ~(1 << SCL_PIN); // Clock pulse LOW 
    byte <<= 1; // Shift to next bit 
  } 
  // Clock pulse for Ack/Nack (ignoring actual read check for brevity) 
  PORTC |= (1 << SCL_PIN); 
  _delay_us(2);
  PORTC &= ~(1 << SCL_PIN); 
} 

// 2. OLED Specific Communication Functions 
#define OLED_ADDR 0x78 // Standard 7-bit I2C Address 0x3C shifted left for Write (0x3C << 1) 
void OLED_WriteCmd(uint8_t cmd) { 
  I2C_Start(); 
  I2C_WriteByte(OLED_ADDR); 
  I2C_WriteByte(0x00); // Co = 0, D/C = 0 -> Control byte tells screen: "Commands Incoming" 
  I2C_WriteByte(cmd); 
  I2C_Stop(); 
} 

void OLED_WriteData(uint8_t data) { 
  I2C_Start(); 
  I2C_WriteByte(OLED_ADDR); 
  I2C_WriteByte(0x40); // Co = 0, D/C = 1 -> Control byte tells screen: "Visual Data Incoming" 
  I2C_WriteByte(data); 
  I2C_Stop(); 
} 

// 3. Hardware Initialization Sequence 
void OLED_Init(void) { 
  _delay_ms(100); // Wait for screen internal power to stabilize 
  OLED_WriteCmd(0xAE); // Display OFF (Sleep Mode) 
  OLED_WriteCmd(0x20); // Set Memory Addressing Mode 
  OLED_WriteCmd(0x02); // Page Addressing Mode (Fills lines chunk by chunk) 
  OLED_WriteCmd(0xA8); // Set Multiplex Ratio 
  OLED_WriteCmd(0x3F); // 64MUX (Sets vertical height to 64 pixels) 
  OLED_WriteCmd(0x8D); // Charge Pump Configuration 
  OLED_WriteCmd(0x14); // Enable internal Charge Pump (Required to turn on pixels!) 
  OLED_WriteCmd(0xAF); // Display ON (Wake panel from sleep)
  _delay_ms(10); 
} 

// 4. Clear Screen Sequence 
void OLED_Clear(void) { 
  // Loop through all 8 structural vertical Pages 
  for (uint8_t page = 0; page < 8; page++) { 
    OLED_WriteCmd(0xB0 + page); // Set target Page start address 
    OLED_WriteCmd(0x00); // Set lower column start address to 0 
    OLED_WriteCmd(0x10); // Set higher column start address to 0 
    // Wipe all 128 horizontal columns in this page layout 
    for (uint8_t col = 0; col < 128; col++) { 
      OLED_WriteData(0x00); // Send 0x00 to turn off all 8 pixels in this stripe segment 
    } 
  } 
} 

// 5. Bitmap Data (stored in Flash Memory)
// 'images', 128x64px
const unsigned char epd_bitmap_images [] PROGMEM = {
	0x3c, 0x1e, 0x9e, 0xf7, 0xf1, 0xf0, 0x80, 0x80, 0x00, 0x02, 0x00, 0x00, 0x00, 0x00, 0x08, 0x0c, 
	0x04, 0x00, 0x01, 0x07, 0x07, 0x05, 0x07, 0x03, 0x03, 0x03, 0x03, 0x03, 0x03, 0x03, 0x07, 0x0f, 
	0x1f, 0x1f, 0x3f, 0xbf, 0xff, 0xff, 0x7f, 0x3f, 0x7f, 0xff, 0xff, 0xff, 0xfe, 0xfa, 0xfa, 0xfb, 
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	0xff, 0xff, 0xff, 0xff, 0xff, 0xff, 0xff, 0xff, 0xff, 0xff, 0xff, 0xff, 0xff, 0xff, 0xff, 0xff
};

// Array of all bitmaps for convenience. (Total bytes used to store images in PROGMEM = 1040)
const int epd_bitmap_allArray_LEN = 1;
const unsigned char* epd_bitmap_allArray[1] = {
	epd_bitmap_images
};


// 6. Display Draw Function
void OLED_DrawBitmap(const uint8_t *bitmap) {
  uint16_t pointer = 0;
  
  // Loop through all 8 pages (vertical sections)
  for (uint8_t page = 0; page < 8; page++) { 
    OLED_WriteCmd(0xB0 + page); // Set active page 0-7
    OLED_WriteCmd(0x00);       // Set lower column address to 0
    OLED_WriteCmd(0x10);       // Set higher column address to 0
    
    // Send 128 columns of data for this page
    for (uint8_t col = 0; col < 128; col++) { 
      // Read a byte from Flash Memory (PROGMEM)
      uint8_t pixel_byte = pgm_read_byte(&(bitmap[pointer++])); 
      
      // Write the physical pixel column to the OLED
      OLED_WriteData(pixel_byte); 
    } 
  } 
}

// 7. Main Function
int main(void) { 
  I2C_Init(); 
  OLED_Init(); 
  OLED_Clear(); 
  
  // Draw the custom image from Flash memory
  OLED_DrawBitmap(epd_bitmap_images); 
  
  while (1) { 
    // The image remains on the screen statically
  } 
}